#!armclang -E --target=arm-arm-none-eabi -mcpu=cortex-m7 -xc

#define m_flash_config_start           0x30000400
#define m_flash_config_size            0x00000c00

#define m_ivt_start                    0x30001000
#define m_ivt_size                     0x00001000

#define m_interrupts_start             0x30002000
#define m_interrupts_size              0x00000400

#define m_text_start                   0x30002400
#define m_text_size                    0x00FBDC00

#define ITCM_SIZE	64*1024
#define DTCM_SIZE	(512 - ITCM_SIZE)*1024
#define WILD_PTR_PLACEHOLDER  32

#define OCRAM_START 0x20240000
#define OCRAM_END   0x20340000

#define DTCM_START  0x20000000
#define DTCM_END	0x20070000


#define SDRAM1      0x80000000
#define SDRAM2     	0x82000000
#define SDRAM2_END  0x84000000

#define SDRAM_CODE_START  0x80000000
#define SRAM_CODE_SIZE 		0x280000
#define SDRAM_DATA_START  0x80280000

#define m_ncache_start                 0x81e00000
#define m_ncache_size                  0x00100000

#define STACK_SIZE 0x1400
#define HEAP_SIZE  0x1000
#define OMV_JPEG_BUF_SIZE   (96 * 1024)
#define RW_DATA_SIZE (220*1024)

#define OMV_FB_TOTAL_SIZE (10*1024*1024)
#define OMV_MAIN_FB_SIZE	(4*720*1280)
#define OMV_FB_ALLOC_SIZE  (OMV_FB_TOTAL_SIZE - OMV_MAIN_FB_SIZE)
#define OMV_FB_ALLOC_OVERLAY_SIZE	220*1024 //fast 

; must use "VECTOR_RAM", "RW_m_data", "VECTOR_ROM" as names to work with "InstallIRQHandler()" API
#include "../../rtconfig.h"
LR_m_text m_flash_config_start m_text_start+m_text_size-m_flash_config_start {   ; load region size_region
	RW_m_config_text m_flash_config_start FIXED m_flash_config_size { ; load address = execution address
	* (.boot_hdr.conf, +FIRST)
	}

	RW_m_ivt_text m_ivt_start FIXED m_ivt_size { ; load address = execution address
	* (.boot_hdr.ivt, +FIRST)
	* (.boot_hdr.boot_data)
	* (.boot_hdr.dcd_data)
	}

	VECTOR_ROM m_interrupts_start FIXED m_interrupts_size { ; load address = execution address
	* (.isr_vector,+FIRST)
	* (InRoot$$Section)
	}
	
	
	

	ER_m_text m_text_start FIXED m_text_size { ; load address = execution address
	.ANY (+RO)
	__main.o
	__scatter.o
	__dczerorl2.o
	__scatter_copy.o
	__scatter_zi.o
	anon$$obj.o
	startup_MIMXRT1176_cm7.o (+RO)
	system_MIMXRT1176_cm7.o  (+RO)
	}
	
	
	

	ER_ITCM 0  +  WILD_PTR_PLACEHOLDER { ; Stack region growing down
		;
		gc.o rt_mem*.o (+RO)
		collections.o array.o xalloc.o (+RO)
		arm_nn_mat*.o (+RO)
		* (.ram_code)

		framebuffer.o (+RO)
	}
	/*
	OVERLAY_FLASH +0 16*1024{
		fsl_flexspi.o (+RO +RW +ZI)
		fsl_flash.o (+RO +RW +ZI)
		drv_norflash.o (+RO +RW +ZI)
		fsl_clock.o (+RO +RW +ZI)
	}
	
	VECTOR_RAM AlignExpr(+0, 1024) EMPTY 0x400{
		
	}	
	*/
	#if EARLY_INIT_SEC
	ER_EARLY_INIT +0 {
		*(.early_init)
	}
	#endif
	ER_ITCM_END ITCM_SIZE - WILD_PTR_PLACEHOLDER EMPTY 0 {}

	DTCM_START_PLACEHOLDER DTCM_START EMPTY 0 {}
	
#if defined(NXP_USING_OPENMV)	
	WEIT_CACHE_AREA +0 EMPTY WEIT_CACHE_SIZE {}
#endif	
	
	
	
	ARM_LIB_STACK +0 EMPTY STACK_SIZE {}
	ARM_LIB_HEAP +0 EMPTY HEAP_SIZE ; Heap region growing up
	{}
	
	RW_m_data +0 (DTCM_END - DTCM_START - STACK_SIZE-HEAP_SIZE-WEIT_CACHE_SIZE){ ; RW data
		*(.dmaFramebuffer)
		.ANY (+RW +ZI)
		* (NonCacheable.init)
		* (*NonCacheable)
	}
	

	DTCM_END_PLACEHOLDER DTCM_END EMPTY 0 {}
	
	OCRAM_START_PLACEHOLDER OCRAM_START EMPTY 0{}
	#define FB_ALLOC_SIZE (220*1024)

	OMV_FB_ALLOC_OVERLAY OCRAM_START EMPTY  FB_ALLOC_SIZE {}
	OMV_FB_ALLOC_OVERLAY_END +0 EMPTY 0 {}	
	
	OCRAM_AREA OCRAM_START+FB_ALLOC_SIZE EMPTY OCRAM_END-OCRAM_START-FB_ALLOC_SIZE {}
	OCRAM_AREA_END +0 EMPTY 0 {}
	OCRAM_END_PLACEHOLDER OCRAM_END EMPTY 0 {}
	
	SRAM_CODE SDRAM_CODE_START   SRAM_CODE_SIZE{
	*.o (+RO)
	}
	
	
	#define RTT_HEAP_SIZE 512*1024
	RTT_HEAP SDRAM_DATA_START EMPTY RTT_HEAP_SIZE{} 
	#if defined(NXP_USING_MICROPYTHON) 	
	
	RTT_MPY_THREAD_STACK +0 EMPTY NXP_MICROPYTHON_THREAD_STACK_SIZE{}
	#endif	
	#if defined(NXP_USING_MICROPYTHON) 	
	MPY_HEAP_START +0 EMPTY PKG_MICROPYTHON_HEAP_SIZE{}
	#endif	
	
	
#if defined(NXP_USING_OPENMV)		
	OMV_MAIN_FB +0 EMPTY OMV_MAIN_FB_SIZE + 3*1024*1024 {}
	OMV_FB_END +0 EMPTY OMV_FB_ALLOC_SIZE + 8*1024*1024{}
	OMV_FB_ALLOC +0 EMPTY  16{}
	
#endif	
	
	RW_m_ncache m_ncache_start m_ncache_size {} ; ncache data
	
	USB_BUFFER +0{
		* (.usb_buf)
		
		*(*m_usb_dma_init_data)
		*(*m_usb_dma_noninit_data)
		}
	RW_m_ncache_unused +0 EMPTY m_ncache_size-ImageLength(USB_BUFFER){}	
	RW_SDRAM2_END SDRAM2_END EMPTY 0 {}
		

}
