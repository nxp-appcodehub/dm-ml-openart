#!armclang -E --target=arm-arm-none-eabi -mcpu=cortex-m7 -xc

#define STACK_SIZE 0x2000
#define ROM_BASE	0x80000000
#define IVT_BASE	0x80001000

#define ITCM_SIZE	64*1024
#define DTCM_SIZE	(512-64)*1024
#define WILD_PTR_PLACEHOLDER  32

#define OCRAM_START 0x20240000
#define OCRAM_END   0x20340000

#define DTCM_START  0x20000000
#define DTCM_END	0x20070000

#define m_ncache_start                 0x83000000
#define m_ncache_size                  0x01000000

#define SDRAM1      0x80000000
#define SDRAM2     	0x82000000
#define SDRAM2_END  0x84000000

#define STACK_SIZE 0x1400
#define HEAP_SIZE  0x1000
#define OMV_JPEG_BUF_SIZE   (96 * 1024)
#define RW_DATA_SIZE (196*1024)

#define OMV_FB_TOTAL_SIZE (10*1024*1024)
#define OMV_MAIN_FB_SIZE	(4*720*1280)
#define OMV_FB_ALLOC_SIZE  (OMV_FB_TOTAL_SIZE - OMV_MAIN_FB_SIZE)
#define OMV_FB_ALLOC_OVERLAY_SIZE	220*1024 //fast 


; must use "VECTOR_RAM", "RW_m_data", "VECTOR_ROM" as names to work with "InstallIRQHandler()" API
#include "../../rtconfig.h"
LR_XIP_FLASH_INFO ROM_BASE  {
  ; >>> RO regions
	RW_m_config_text +0 0xF000 {
	* (.boot_hdr.conf, +FIRST)
	}
}

LR_XIP_FLASH_IVT IVT_BASE {
	ER_boot_hdr_ivt +0 0x20 {
	* (.boot_hdr.ivt)
	}
	ER_boot_hdr_boot_data +0 0x10{
	* (.boot_hdr.boot_data)
	}  
	ER_boot_hdr_dcd_data +0 {
	* (.boot_hdr.dcd_data)
	}
}

LR_XIP_FLASH ROM_BASE + 0x2000 {
	VECTOR_ROM +0 0x400 { ; vector table
		* (.isr_vector,+FIRST)
		* (InRoot$$Section)
	}
	
	TEXT_ROM +0  { ; load address = execution address
		.ANY (+RO)
	}


	ER_ITCM 0  +  WILD_PTR_PLACEHOLDER { ; Stack region growing down
		;
		gc.o rt_mem*.o (+RO)
		collections.o array.o xalloc.o (+RO)
		arm_nn_mat*.o (+RO)
		* (.ram_code)
	}
	
	; must align to 1024
	VECTOR_RAM AlignExpr(+0, 1024) EMPTY 0x400{
		
	}
#if EARLY_INIT_SEC
	ER_EARLY_INIT +0 {
		*(.early_init)
	}
#endif
	ER_ITCM_END ITCM_SIZE - WILD_PTR_PLACEHOLDER EMPTY 0 {}

	DTCM_START_PLACEHOLDER DTCM_START EMPTY 0 {}
	
#if defined(NXP_USING_OPENMV)	
	WEIT_CACHE_AREA +0 EMPTY WEIT_CACHE_SIZE {}
#endif	
	
	OMV_FB_ALLOC_OVERLAY +0 EMPTY (220*1024) {}
	OMV_FB_ALLOC_OVERLAY_END +0 EMPTY 0 {}	
	
	ARM_LIB_STACK +0 EMPTY STACK_SIZE {}
	ARM_LIB_HEAP +0 EMPTY HEAP_SIZE ; Heap region growing up
	{}
	
	RW_m_data +0 RW_DATA_SIZE{ ; RW data
		.ANY (+RW +ZI)
		* (NonCacheable.init)
		* (*NonCacheable)
	}
	
	ER_LVGL_ZI_DATA +0 NOCOMPRESS{
		lv_*.o (+RW, +ZI)
	}
	DTCM_END_PLACEHOLDER DTCM_END EMPTY 0 {}
	
	
    OCRAM_START_PLACEHOLDER OCRAM_START EMPTY 0{}
	#define OCRAM_CODE_SIZE 196*1024
	OCRAM_CODE +0 OCRAM_CODE_SIZE{
	
		draw.o (+RO)
		blob.o  (+RO)
	}
	
	OCRAM_AREA OCRAM_START+OCRAM_CODE_SIZE EMPTY OCRAM_END-OCRAM_START-OCRAM_CODE_SIZE {}
	OCRAM_AREA_END +0 EMPTY 0 {}
	OCRAM_END_PLACEHOLDER OCRAM_END EMPTY 0 {}
	

	RW_SRAM 0x81000000  EMPTY 0 {}	
	
	#define RTT_HEAP_SIZE 512*1024
	RTT_HEAP +0 EMPTY RTT_HEAP_SIZE{} 
	#if defined(NXP_USING_MICROPYTHON) 	
	
	RTT_MPY_THREAD_STACK +0 EMPTY NXP_MICROPYTHON_THREAD_STACK_SIZE{}
	#endif	
	#if defined(NXP_USING_MICROPYTHON) 	
	MPY_HEAP_START +0 EMPTY PKG_MICROPYTHON_HEAP_SIZE{}
	#endif	
	ER_LCD_FB +0 UNINIT 1*1024  {
		* (.lcd_fb)
	}
	
#if defined(NXP_USING_OPENMV)		
	OMV_MAIN_FB +0 EMPTY OMV_MAIN_FB_SIZE + 4*1024*1024 {}
	OMV_FB_END +0 EMPTY OMV_FB_ALLOC_SIZE + 12*1024*1024{}
	OMV_FB_ALLOC +0 EMPTY  16{}
	
#endif	
	
	RW_m_ncache m_ncache_start m_ncache_size {} ; ncache data
	
	USB_BUFFER +0{
		* (.usb_buf)
		*(*m_usb_dma_init_data)
		*(*m_usb_dma_noninit_data)
		}
	RW_m_ncache_unused +0 EMPTY m_ncache_size-ImageLength(USB_BUFFER){}	
	RW_SDRAM2_END SDRAM2_END EMPTY 0 {}

}
